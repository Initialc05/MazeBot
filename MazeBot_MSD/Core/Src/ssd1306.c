/**
 * @file ssd1306.c
 * @brief SSD1306 I2C 驱动 + 6x8 字体 + 1024B 帧缓冲
 */
#include "ssd1306.h"
#include "main.h"
#include <string.h>

extern I2C_HandleTypeDef hi2c1;

/* 帧缓冲: 128x64 / 8 = 1024 bytes */
static uint8_t framebuf[SSD1306_WIDTH * SSD1306_HEIGHT / 8];

/* I2C 超时 */
#define I2C_TIMEOUT  100

/* ==================== 6x8 ASCII 字体 (32~126) ==================== */
static const uint8_t font6x8[][6] = {
    {0x00,0x00,0x00,0x00,0x00,0x00}, /* 32 ' ' */
    {0x00,0x00,0x5F,0x00,0x00,0x00}, /* 33 '!' */
    {0x00,0x07,0x00,0x07,0x00,0x00}, /* 34 '"' */
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    {0x08,0x08,0x2A,0x1C,0x08,0x00}, /*126 '~' */
};

/* ==================== I2C 底层 ==================== */
static void ssd1306_WriteCmd(uint8_t cmd)
{
    HAL_I2C_Mem_Write(&hi2c1, SSD1306_ADDR, 0x00, 1, &cmd, 1, I2C_TIMEOUT);
}

/* ==================== 初始化 ==================== */
bool SSD1306_Init(void)
{
    HAL_Delay(100); /* 等待 OLED 上电稳定 */

    /* 先探测 I2C 设备是否存在 */
    if (HAL_I2C_IsDeviceReady(&hi2c1, SSD1306_ADDR, 3, 100) != HAL_OK) {
        return false; /* OLED 未连接或 I2C 故障 */
    }

    static const uint8_t initSeq[] = {
        0xAE,       /* Display OFF */
        0xD5, 0x80, /* Set clock div */
        0xA8, 0x3F, /* Set multiplex 64 */
        0xD3, 0x00, /* Set display offset 0 */
        0x40,       /* Set start line 0 */
        0x8D, 0x14, /* Charge pump ON */
        0x20, 0x00, /* Horizontal addressing mode */
        0xA1,       /* Segment remap */
        0xC8,       /* COM scan decrement */
        0xDA, 0x12, /* COM pins config */
        0x81, 0xCF, /* Contrast */
        0xD9, 0xF1, /* Pre-charge period */
        0xDB, 0x40, /* VCOMH deselect level */
        0xA4,       /* Display from RAM */
        0xA6,       /* Normal display (not inverted) */
        0xAF,       /* Display ON */
    };

    for (uint16_t i = 0; i < sizeof(initSeq); i++) {
        ssd1306_WriteCmd(initSeq[i]);
    }

    SSD1306_Clear();
    SSD1306_Update();
    return true;
}

/* ==================== 帧缓冲操作 ==================== */
void SSD1306_Clear(void)
{
    memset(framebuf, 0, sizeof(framebuf));
}

void SSD1306_Update(void)
{
    ssd1306_WriteCmd(0x21); /* Column addr */
    ssd1306_WriteCmd(0);
    ssd1306_WriteCmd(127);
    ssd1306_WriteCmd(0x22); /* Page addr */
    ssd1306_WriteCmd(0);
    ssd1306_WriteCmd(7);

    HAL_I2C_Mem_Write(&hi2c1, SSD1306_ADDR, 0x40, 1,
                       framebuf, sizeof(framebuf), I2C_TIMEOUT);
}

void SSD1306_DrawPixel(uint8_t x, uint8_t y, bool on)
{
    if (x >= SSD1306_WIDTH || y >= SSD1306_HEIGHT) return;
    if (on)
        framebuf[x + (y / 8) * SSD1306_WIDTH] |=  (1 << (y & 7));
    else
        framebuf[x + (y / 8) * SSD1306_WIDTH] &= ~(1 << (y & 7));
}

void SSD1306_WriteChar(uint8_t x, uint8_t page, char c)
{
    if (c < 32 || c > 126) c = ' ';
    if (x + 6 > SSD1306_WIDTH || page >= 8) return;

    const uint8_t *glyph = font6x8[c - 32];
    uint16_t base = page * SSD1306_WIDTH + x;
    for (uint8_t i = 0; i < 6; i++) {
        framebuf[base + i] = glyph[i];
    }
}

void SSD1306_WriteString(uint8_t x, uint8_t page, const char *str)
{
    while (*str) {
        if (x + 6 > SSD1306_WIDTH) break;
        SSD1306_WriteChar(x, page, *str++);
        x += 6;
    }
}

void SSD1306_SetContrast(uint8_t val)
{
    ssd1306_WriteCmd(0x81);
    ssd1306_WriteCmd(val);
}
